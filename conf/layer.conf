## conf/layer.conf
```bitbake
# We have a conf and classes directory, add to BBPATH
BBPATH .= ":${LAYERDIR}"

# We have recipes-* directories, add to BBFILES
BBFILES += " \
	${LAYERDIR}/recipes-*/*.bb \
	${LAYERDIR}/recipes-*/*.bbappend \
	${LAYERDIR}/recipes-*/*/*.bb \
	${LAYERDIR}/recipes-*/*/*.bbappend \
"

BBFILE_COLLECTIONS += "gnk"
BBFILE_PATTERN_gnk = "^${LAYERDIR}/"
BBFILE_PRIORITY_gnk = "18"

LAYERSERIES_COMPAT_gnk = "dunfell"
```

## conf/machine/gnk-rzg2l.conf
```bitbake
#@TYPE: Machine
#@NAME: smarc-rzg2l machine
#@DESCRIPTION: RZ/G2L SMARC platform

SOC_FAMILY = "r9a07g044l"
require conf/machine/include/rzg2l-common.inc
require conf/machine/include/cip-core.inc

DEFAULTTUNE ?= "cortexa55"

TUNE_CONF ?= "conf/machine/include/tune-cortexa55.inc"
require ${TUNE_CONF}

PREFERRED_PROVIDER_virtual/kernel="linux-renesas"

UBOOT_CONFIG ??= "smarc-rzv2l-gnk"
UBOOT_CONFIG[smarc-rzv2l-gnk] = "smarc-rzg2l-gnk_defconfig"

# flash writer
EXTRA_IMAGEDEPENDS += " flash-writer"

# Supported devicetree
KERNEL_DEVICETREE = " \
	renesas/r9a07g044l2-smarc-gnk.dtb \
"

# Support board with PMIC. Default:yes.
# With this option enabled, build both bin files for PMIC board and Concrete board.
PMIC_SUPPORT ?= "1"

IMAGE_BOOT_FILES = " \
	bl2_bp-${MACHINE}_pmic.srec \
	fip-${MACHINE}_pmic.srec \
	Flash_Writer_SCIF_GNK_RZG2L_DDR4_1GB_1PCS.mot \
"
```
